// This file is autogenerated -- do not edit.

static const char cmd_help_B58E[] PROGMEM = PSTR("+ ( x1 x2 - x3) Add: x3 = x1 + x2.");
static const char cmd_help_B588[] PROGMEM = PSTR("- ( x1 x2 - x3) Subtract: x3 = x1 - x2.");
static const char cmd_help_B58A[] PROGMEM = PSTR("/ ( d1 d2 - d3) Signed dvide: d3 = d1 / d2.");
static const char cmd_help_73DF[] PROGMEM = PSTR("U/ ( u1 u2 - u3) Signed dvide: u3 = u1 / u2.");
static const char cmd_help_7A79[] PROGMEM = PSTR("NEGATE ( d1 - d2) Negate signed value: d2 = -d1.");
static const char cmd_help_B586[] PROGMEM = PSTR("# ( - ) Comment, rest of input ignored.");
static const char cmd_help_4069[] PROGMEM = PSTR("RAISE ( i - ) Raise value as exception.");
static const char cmd_help_C745[] PROGMEM = PSTR("EXIT ( - ?) Exit console.");
static const char cmd_help_13B4[] PROGMEM = PSTR("PICK (u - x) Copy stack item by index.");
static const char cmd_help_398B[] PROGMEM = PSTR("OVER (x1 x2 - x1 x2 x1) Copy second stack item.");

static const char* const help_cmds[] PROGMEM = {
    cmd_help_B58E,
    cmd_help_B588,
    cmd_help_B58A,
    cmd_help_73DF,
    cmd_help_7A79,
    cmd_help_B586,
    cmd_help_4069,
    cmd_help_C745,
    cmd_help_13B4,
    cmd_help_398B,
};

static const uint16_t help_hashes[] PROGMEM = {
    0xB58E,
    0xB588,
    0xB58A,
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    0x398B,
};

